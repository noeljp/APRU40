## sdkconfig.defaults
```kconfig
# Configuration Bluetooth Classic
CONFIG_BT_ENABLED=y
CONFIG_BT_BLUEDROID_ENABLED=y
CONFIG_BT_CLASSIC_ENABLED=y
CONFIG_BT_SPP_ENABLED=y
CONFIG_BT_SSP_ENABLED=y

# Configuration WiFi (pour ESP-NOW)
CONFIG_ESP_WIFI_ENABLED=y

# NVS (requis pour Bluetooth pairing)
CONFIG_NVS_ENCRYPTION=n
```
